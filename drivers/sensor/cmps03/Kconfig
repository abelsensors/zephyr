## drivers/sensor/cmps03/Kconfig
```kconfig
# BMP280 temperature and pressure sensor configuration options

# Copyright (c) 2016 Intel Corporation
# Copyright (c) 2017 IpTronix S.r.l.
# SPDX-License-Identifier: Apache-2.0

menuconfig CMPS03
	bool "CMPS03 sensor"
	depends on I2C
	help
	  Enable driver for CMPS03 I2C-based Compass Sensor.
```

## drivers/sensor/neo_m8/Kconfig
```kconfig
# Abel Sensors
#
# Copyright (c) 2021, Piotr Mienkowski
# SPDX-License-Identifier: Apache-2.0
#

config NEO_M8
	bool "ublox neo m8 driver"
	default n
	help
	  Atmel SAM MCU family Quadrature Decoder (TC) driver.
```

## dts/bindings/gpio/fcs,fxl6408.yaml
```yaml
# Copyright (c) 2021 Abel Sensors
# SPDX-License-Identifier: Apache-2.0

description: FXL6408 I2C-based GPIO expander

compatible: "fcs,fxl6408"

include: [gpio-controller.yaml, i2c-device.yaml]

properties:
    label:
      required: true

    has-pud:
      type: boolean
      required: false
      description: Supports pull-up/pull-down

    "#gpio-cells":
      const: 1

gpio-cells:
  - pin
  - flags
```

## dts/bindings/sensor/devantech,cmps03.yaml
```yaml
description: |
  Devantech CMPS03 Compass Sensor.  See more info at:
  -

compatible: "devantech,cmps03"

include: i2c-device.yaml

properties:
  int1-gpios:
    type: phandle-array
    required: false
    description: |
      Identifies pin for the INT1 signal on the sensor.

  is-bmc150:
    type: boolean
    required: false
    description: |
      Specifies that the driver should adapt to the accelerometer
      capability provided by the BMC150 6-axis eCompass.  This affects
      the chip ID and the resolution of the measurements.
```

## dts/bindings/sensor/ublox,neo-m8.yaml
```yaml
# Copyright (c) 2021, Abel Sensors
# SPDX-License-Identifier: Apache-2.0

description: "ublox neo-m8 GNSS module"
    
compatible: "ublox,neo-m8"

include: i2c-device.yaml
```

## dts/bindings/sensor/ublox,neom8.yaml
```yaml
# Copyright (c) 2021, Abel Sensors
# SPDX-License-Identifier: Apache-2.0

description: "ublox neo-m8 GNSS module"
    
compatible: "ublox,neom8"

include: i2c-device.yaml
```

## samples/drivers/ublox_m8/stm32l1_disco/Kconfig/Kconfig.modules
```kconfig
menu "hal_nordic (/home/sander/zephyrproject/modules/hal/nordic)"
osource "$(ZEPHYR_HAL_NORDIC_KCONFIG)"
config ZEPHYR_HAL_NORDIC_MODULE
	bool
	default y
endmenu
menu "sof (/home/sander/zephyrproject/modules/audio/sof)"
osource "/home/sander/zephyrproject/modules/audio/sof/zephyr/Kconfig"
config ZEPHYR_SOF_MODULE
	bool
	default y
endmenu
menu "trusted-firmware-m (/home/sander/zephyrproject/modules/tee/tfm)"
osource "$(ZEPHYR_TRUSTED_FIRMWARE_M_KCONFIG)"
config ZEPHYR_TRUSTED_FIRMWARE_M_MODULE
	bool
	default y
endmenu
menu "nanopb (/home/sander/zephyrproject/modules/lib/nanopb)"
osource "$(ZEPHYR_NANOPB_KCONFIG)"
config ZEPHYR_NANOPB_MODULE
	bool
	default y
endmenu
menu "tensorflow (/home/sander/zephyrproject/modules/lib/tensorflow)"
osource "$(ZEPHYR_TENSORFLOW_KCONFIG)"
config ZEPHYR_TENSORFLOW_MODULE
	bool
	default y
endmenu
```

## tests/drivers/modem/ublox_sara_n310/testcase.yaml
```yaml
tests:
  ublox_sara-n310.maintest:
    tags: modem
    platform_allow: qemu_cortex_m3 qemu_cortex_m0
```

## tests/drivers/modem/ublox_sara_n310/twister-out/qemu_cortex_m0/tests/drivers/modem/ublox_sara_n310/ublox_sara-n310.maintest/Kconfig/Kconfig.modules
```kconfig
menu "hal_nordic (/home/ilagas/zephyrproject/modules/hal/nordic)"
osource "$(ZEPHYR_HAL_NORDIC_KCONFIG)"
config ZEPHYR_HAL_NORDIC_MODULE
	bool
	default y
endmenu
menu "sof (/home/ilagas/zephyrproject/modules/audio/sof)"
osource "/home/ilagas/zephyrproject/modules/audio/sof/zephyr/Kconfig"
config ZEPHYR_SOF_MODULE
	bool
	default y
endmenu
menu "TraceRecorder (/home/ilagas/zephyrproject/modules/debug/TraceRecorder)"
osource "/home/ilagas/zephyrproject/modules/debug/TraceRecorder/kernelports/Zephyr/Kconfig"
config ZEPHYR_TRACERECORDER_MODULE
	bool
	default y
endmenu
menu "trusted-firmware-m (/home/ilagas/zephyrproject/modules/tee/tfm)"
osource "$(ZEPHYR_TRUSTED_FIRMWARE_M_KCONFIG)"
config ZEPHYR_TRUSTED_FIRMWARE_M_MODULE
	bool
	default y
endmenu
menu "nanopb (/home/ilagas/zephyrproject/modules/lib/nanopb)"
osource "$(ZEPHYR_NANOPB_KCONFIG)"
config ZEPHYR_NANOPB_MODULE
	bool
	default y
endmenu
menu "tensorflow (/home/ilagas/zephyrproject/modules/lib/tensorflow)"
osource "$(ZEPHYR_TENSORFLOW_KCONFIG)"
config ZEPHYR_TENSORFLOW_MODULE
	bool
	default y
endmenu
```

## tests/drivers/modem/ublox_sara_n310/twister-out/qemu_cortex_m0/tests/drivers/modem/ublox_sara_n310/ublox_sara-n310.maintest/Kconfig/Kconfig.soc.arch
```kconfig
osource "/home/ilagas/zephyrproject/zephyr/soc/$(ARCH)/Kconfig"
osource "/home/ilagas/zephyrproject/zephyr/soc/$(ARCH)/*/Kconfig"
```

## tests/drivers/sensor/lis3dh/testcase.yaml
```yaml
tests:
  sample.sensor.lis2dh:
    tags: sensor
    platform_allow: qemu_cortex_m3
```
