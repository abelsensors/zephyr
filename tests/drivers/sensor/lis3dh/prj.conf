## CMakeLists.txt
```
#
# Copyright (c) 2018, Yannis Damigos
#
# SPDX-License-Identifier: Apache-2.0
#

cmake_minimum_required(VERSION 3.13.1)
find_package(Zephyr REQUIRED HINTS $ENV{ZEPHYR_BASE})
project(lis2dh)


zephyr_library_sources(
    # ${ZEPHYR_BASE}/drivers/sensor/lis2dh/lis2dh_trigger.c
    # ${ZEPHYR_BASE}/drivers/sensor/lis2dh/lis2dh.c
    # ${ZEPHYR_BASE}/drivers/sensor/lis2dh/lis2dh_spi.c
   ${ZEPHYR_BASE}/drivers/sensor/lis2dh/lis2dh.h
)

zephyr_library_include_directories(
    ${ZEPHYR_BASE}/drivers/sensor/lis2dh/
	)

FILE(GLOB app_sources src/*.c)
target_sources(app PRIVATE ${app_sources})
```

## prj.conf
```kconfig
# CONFIG_STDOUT_CONSOLE=y
CONFIG_I2C=y


CONFIG_SENSOR=y
CONFIG_LIS2DH=y
CONFIG_LIS2DH_TRIGGER_GLOBAL_THREAD=y
# CONFIG_LIS2DH_TRIGGER=y
CONFIG_CBPRINTF_FP_SUPPORT=y
CONFIG_LIS2DH_ODR_RUNTIME=y
CONFIG_LIS2DH_ACCEL_RANGE_16G=y

CONFIG_LOG=y
CONFIG_LIS2DH_TRIGGER_OWN_THREAD=y
CONFIG_LIS2DH_WAKE_THS=8
CONFIG_LIS2DH_WAKE_DUR=1
CONFIG_LIS2DH_OPER_MODE_NORMAL=y

CONFIG_ZTEST=y
CONFIG_ZTEST_MOCKING=y
CONFIG_ZTEST=y
CONFIG_IRQ_OFFLOAD=y
CONFIG_TEST_USERSPACE=y
CONFIG_ZTEST_FATAL_HOOK=y

CONFIG_STDOUT_CONSOLE=y
CONFIG_I2C=y
CONFIG_SENSOR=y
CONFIG_LIS2DH=y
CONFIG_CBPRINTF_FP_SUPPORT=y
```

## src/main.c
```c
/*
 * Copyright (c) 2021 Abel Sensor
 *
 * SPDX-License-Identifier: Apache-2.0
 */

#include <zephyr.h>
#include <net/socket.h>
#include <ztest.h>
#include <device.h>
#include <sys/fdtable.h>

void test_basic()
{
	zassert_true(true, "");
	const struct device *sensor = 
	device_get_binding(DT_LABEL(DT_INST(0, st_lis2dh)));
	zassert_not_null(sensor, "sensor binding not working");

}

void test_main(void)
{
	ztest_test_suite(lis3dh_test, 
	ztest_unit_test(test_basic)
	);
	ztest_run_test_suite(lis3dh_test);
}
```

## src/lis3dh_i2c_mock.c
```c
#include <zephyr.h>
#include <net/socket.h>
#include <ztest.h>
#include <device.h>
#include <sys/fdtable.h>
#include "lis2dh.h"


static int lis2dh_i2c_read_data_mock(const struct device *dev, uint8_t reg_addr,
				 uint8_t *value, uint8_t len)
{
	// struct lis2dh_data *data = dev->data;
	// const struct lis2dh_config *cfg = dev->config;

	// return i2c_burst_read(data->bus, cfg->bus_cfg.i2c_slv_addr,
	// 		      reg_addr | LIS2DH_AUTOINCREMENT_ADDR,
	// 		      value, len);

    return 0;
}

static int lis2dh_i2c_write_data_mock(const struct device *dev, uint8_t reg_addr,
				  uint8_t *value, uint8_t len)
{
	// struct lis2dh_data *data = dev->data;
	// const struct lis2dh_config *cfg = dev->config;

	// return i2c_burst_write(data->bus, cfg->bus_cfg.i2c_slv_addr,
	// 		       reg_addr | LIS2DH_AUTOINCREMENT_ADDR,
	// 		       value, len);

    return 0;
}

static int lis2dh_i2c_read_reg_mock(const struct device *dev, uint8_t reg_addr,
				uint8_t *value)
{
	// struct lis2dh_data *data = dev->data;
	// const struct lis2dh_config *cfg = dev->config;

	// return i2c_reg_read_byte(data->bus,
	// 			 cfg->bus_cfg.i2c_slv_addr,
	// 			 reg_addr, value);
    return 0;
}

static int lis2dh_i2c_write_reg_mock(const struct device *dev, uint8_t reg_addr,
				uint8_t value)
{
	// struct lis2dh_data *data = dev->data;
	// const struct lis2dh_config *cfg = dev->config;

	// return i2c_reg_write_byte(data->bus,
	// 			  cfg->bus_cfg.i2c_slv_addr,
	// 			  reg_addr, value);
    return 0;
}

static int lis2dh_i2c_update_reg_mock(const struct device *dev, uint8_t reg_addr,
				  uint8_t mask, uint8_t value)
{
// 	struct lis2dh_data *data = dev->data;
// 	const struct lis2dh_config *cfg = dev->config;

// 	return i2c_reg_update_byte(data->bus,
// 				   cfg->bus_cfg.i2c_slv_addr,
// 				   reg_addr, mask, value);
//
return 0; 
}

static const struct lis2dh_transfer_function lis2dh_i2c_transfer_fn = {
	.read_data = lis2dh_i2c_read_data_mock,
	.write_data = lis2dh_i2c_write_data_mock,
	.read_reg  = lis2dh_i2c_read_reg_mock,
	.write_reg  = lis2dh_i2c_write_reg_mock,
	.update_reg = lis2dh_i2c_update_reg_mock,
};

int lis2dh_i2c_init(const struct device *dev)
{
	struct lis2dh_data *data = dev->data;

	data->hw_tf = &lis2dh_i2c_transfer_fn;

	return 0;
}
```

## src/stub.c
```c
// #include "lis2dh.c"
```
